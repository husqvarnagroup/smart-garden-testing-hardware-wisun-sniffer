## CMakeLists.txt
```
# SPDX-FileCopyrightText: Copyright (c) 2026 GARDENA GmbH
# SPDX-License-Identifier: GPL-3.0-or-later

cmake_minimum_required(VERSION 3.20.0)

find_package(Zephyr REQUIRED HINTS $ENV{ZEPHYR_BASE} PATHS ../../../zephyr NO_DEFAULT_PATH)

project(wisun_sniffer)

target_sources(
    app
    PRIVATE
        src/led.c
        src/main.c
        src/pcapng.c
        src/si4467_fec.c
        src/si4467_wisun.c
        src/tap.c
        src/usb.c
        src/wisun_phy.c
)

# The Viterbi decoder is the only thing here with an inner loop that runs thousands of times per
# frame, and the application is otherwise built for size. Speed for this one file, because what it
# decides is whether a frame is decoded before the next one has filled the receive FIFO -- and an
# acknowledgment follows the frame it answers by well under a millisecond.
set_source_files_properties(
    src/si4467_fec.c
    PROPERTIES
        COMPILE_OPTIONS
            "-O2"
)
```

## Kconfig
```
# SPDX-FileCopyrightText: Copyright (c) 2026 GARDENA GmbH
# SPDX-License-Identifier: GPL-3.0-or-later

mainmenu "Wi-SUN Sniffer App"

config WISUN_SNIFFER_DEFAULT_REGULATORY_DOMAIN
	int "Wi-SUN regulatory domain to listen in after boot"
	default 3
	range 0 15
	help
	  The domain decides which channel plans and operating modes may be
	  combined; Wi-SUN PHY 2.03 table 8. 0 WW, 1 NA, 2 JP, 3 EU, 4 CN, 5 IN,
	  6 MX, 7 BZ, 8 AU/NZ, 9 KR, 10 PH, 11 MY, 12 HK, 13 SG, 14 TH, 15 VN.

	  The transceiver on the dongle is matched for 863 to 876 MHz, so only the
	  EU domain is within reach of the hardware.

config WISUN_SNIFFER_DEFAULT_CHAN_PLAN_ID
	int "Wi-SUN ChanPlanID to listen on after boot"
	default 32
	range 0 255
	help
	  Fixes the centre frequency of channel zero and the channel spacing;
	  Wi-SUN PHY 2.03 table 7. ChanPlanID 32 is 863_870_100, so channel zero
	  is at 863.1 MHz with 100 kHz spacing.

config WISUN_SNIFFER_DEFAULT_PHY_MODE_ID
	int "Wi-SUN PhyModeID to listen for after boot"
	default 1
	range 1 24
	help
	  Fixes the symbol rate, the modulation index and whether frames are
	  forward error corrected; Wi-SUN PHY 2.03 tables 11 and 19. Only the
	  modes with a modulation index of 0.5 can be programmed: 0x01
	  (50 ksym/s), 0x03 (100 ksym/s) and 0x05 (150 ksym/s), and their FEC
	  variants 0x11, 0x13 and 0x15, which are the same rates again.

	  A node using FEC is not heard on the uncoded mode, nor the other way
	  round, so this has to match the network being listened to. Written
	  here in decimal because Kconfig has no hex integers: 0x11, 0x13 and
	  0x15 are 17, 19 and 21.

config WISUN_SNIFFER_DEFAULT_CHANNEL
	int "Wi-SUN channel to listen on after boot"
	default 0
	range 0 255
	help
	  Channel number within the configured channel plan. With ChanPlanID 32
	  the centre frequency is 863.1 MHz + channel * 100 kHz, so channel 0 is
	  863.1 MHz.

config WISUN_SNIFFER_CAPTURE_BUF_SIZE
	int "Size of the PCAP-NG capture staging buffer, in octets"
	default 16384
	range 2176 65536
	help
	  Absorbs bursts of frames that arrive faster than the USB host reads them.
	  Once it is full, whole frames are dropped rather than blocks truncated, so
	  the capture stays well formed; "wisun_sniffer stats" counts the drops.

	  Must hold at least one largest possible block: a 2047 octet PSDU, a 44
	  octet TAP header and 32 octets of block overhead. The default is far above
	  that minimum on purpose. A drop here is a hole in somebody's capture that
	  they find out about afterwards, and the dongle has memory to spare, so the
	  buffer is sized for the worst burst rather than the usual one: about
	  seven largest-possible frames, or a hundred of the sizes this network
	  actually sends.

config WISUN_SNIFFER_USB_PID
	hex "USB product ID"
	default 0xB823
	help
	  Distinguishes this firmware from the other ones for the dongle when it
	  enumerates. In use so far: 0xB820 (board default), 0xB821 and 0xB822
	  (other firmwares). The vendor ID is Nordic's, as the board's.

config WISUN_SNIFFER_USB_PRODUCT
	string "USB product string"
	default "Wi-SUN Sniffer Dongle"
	help
	  Part of the /dev/serial/by-id names the capture script looks for.

source "Kconfig.zephyr"
```

## sample.yaml
```
# SPDX-FileCopyrightText: Copyright (c) 2026 GARDENA GmbH
# SPDX-License-Identifier: GPL-3.0-or-later

sample:
  name: Wi-SUN Sniffer
  description: >-
    Receive Wi-SUN FAN frames with the Si4467 transceiver on the dongle board
    and stream them to Wireshark as PCAP-NG.

tests:
  # Starts at the reset vector, so a bare dongle can be flashed with a debug probe and nothing
  # else. This is the one to develop against.
  sample.wisun_sniffer:
    platform_allow: si4467_dongle/nrf52840
    integration_platforms:
      - si4467_dongle/nrf52840
    tags:
      - wisun
      - sniffer
      - si4467
    build_only: true

  # The same firmware, linked to load through MCUboot so the dongle can be updated over USB DFU.
  # The image is unsigned and needs no key; see overlays/si4467_dongle-mcuboot.conf.
  sample.wisun_sniffer.mcuboot:
    platform_allow: si4467_dongle/nrf52840
    integration_platforms:
      - si4467_dongle/nrf52840
    extra_args:
      - EXTRA_CONF_FILE=overlays/si4467_dongle-mcuboot.conf
    tags:
      - wisun
      - sniffer
      - si4467
      - mcuboot
    build_only: true
```

## prj.conf
```kconfig
# SPDX-FileCopyrightText: Copyright (c) 2026 GARDENA GmbH
# SPDX-License-Identifier: GPL-3.0-or-later

# No IP stack is needed: frames go straight from the transceiver to the capture UART.
CONFIG_NETWORKING=n

# Transceiver interface
CONFIG_SPI=y
CONFIG_GPIO=y

# The nIRQ interrupt hands off to the receive thread through a kernel event object.
CONFIG_EVENTS=y

# Console, logging and shell (on cdc_acm_uart0, see boards/si4467_dongle_nrf52840.overlay)
CONFIG_LOG=y
CONFIG_SHELL=y

# Lets the receive path be traced with "log enable dbg si4467_wisun" at the shell, which is far
# quicker than reflashing when a frame does not come out the way it should.
CONFIG_LOG_RUNTIME_FILTERING=y
CONFIG_LOG_CMDS=y
# The shell attaches as a log backend at the compiled level of each module otherwise, which would
# turn that trace on from boot.
CONFIG_SHELL_BACKEND_SERIAL_LOG_LEVEL_INF=y

# Needed to detect when a capture tool opens the capture UART, so the PCAP-NG section header can be
# re-sent for hosts that attach long after boot.
CONFIG_UART_LINE_CTRL=y

# A plain build starts at the reset vector, so a bare dongle can be flashed with a debug probe and
# nothing else. overlays/si4467_dongle-mcuboot.conf builds the same application to load through MCUboot
# instead, which is what a dongle handed out to someone else should carry.
CONFIG_BOOTLOADER_MCUBOOT=n

# This is a diagnostic tool, not a product: keep the safety nets on.
CONFIG_ASSERT=y

# Stacks, all of them above what this application has been measured to need, because none of it
# has been measured. The dongle has 256 KB of RAM and uses a third of it, so the choice is between
# memory nobody will miss and a class of fault that presents as a dongle which has simply stopped.
# CONFIG_HW_STACK_PROTECTION turns an overflow into a message rather than silent corruption, but
# only if the stack is where the guard is; it does not make a stack that is too small correct.
CONFIG_MAIN_STACK_SIZE=2048
CONFIG_SHELL_STACK_SIZE=3072
CONFIG_ISR_STACK_SIZE=3072
CONFIG_SYSTEM_WORKQUEUE_STACK_SIZE=2048
CONFIG_IDLE_STACK_SIZE=512

# The log thread formats the per-frame line, and under load it formats one per frame while the
# receive path is busy. It is also the thread that has to keep running when something has gone
# wrong enough to be worth logging.
CONFIG_LOG_PROCESS_THREAD_STACK_SIZE=3072
```

## boards/dongle_nrf52840.conf
```kconfig
# SPDX-FileCopyrightText: Copyright (c) 2026 GARDENA GmbH
# SPDX-License-Identifier: GPL-3.0-or-later

# Distinguish this dongle from the other firmware variants when it enumerates.
# In use so far: B820 (board default), B821 & B822 (other firmwares).
CONFIG_USB_DEVICE_PID=B823
CONFIG_USB_DEVICE_PRODUCT="Wi-SUN Sniffer Dongle"

# A Wi-SUN PSDU may be up to 2047 bytes; the default 1024 byte ring buffer would drop data on the
# capture interface for large frames. Four times the largest frame rather than twice it, because
# this buffer sits behind the application's own staging buffer and a frame that reaches it has
# already been counted as captured -- losing it here would not show up in the drop counter.
CONFIG_USB_CDC_ACM_RINGBUF_SIZE=8192

# The console is a USB CDC ACM interface, so it does not exist yet when the application starts.
# Hold back log processing until the host has had time to enumerate, otherwise every startup
# message (including transceiver bring-up failures) is lost before anyone can read it.
CONFIG_LOG_PROCESS_THREAD_STARTUP_DELAY_MS=4000
```

## boards/si4467_dongle_nrf52840.conf
```kconfig
# SPDX-FileCopyrightText: Copyright (c) 2026 GARDENA GmbH
# SPDX-License-Identifier: GPL-3.0-or-later

# src/usb.c registers both CDC ACM interfaces; the board's serial backend would register only the
# first.
CONFIG_CDC_ACM_SERIAL_INITIALIZE_AT_BOOT=n

# The console is a USB CDC ACM interface, so it does not exist yet when the application starts.
# Hold back log processing until the host has had time to enumerate, otherwise every startup
# message (including transceiver bring-up failures) is lost before anyone can read it.
CONFIG_LOG_PROCESS_THREAD_STARTUP_DELAY_MS=4000

# Shell output is not held back until a reader raises DTR on the console; tools/ expect the startup
# log to be waiting when they open it.
CONFIG_SHELL_BACKEND_SERIAL_CHECK_DTR=n
```

## boards/si4467_dongle_nrf52840.overlay
```dts
/*
 * SPDX-FileCopyrightText: Copyright (c) 2026 GARDENA GmbH
 * SPDX-License-Identifier: GPL-3.0-or-later
 */

/ {
	chosen {
		/*
		 * Console, log and shell stay on cdc_acm_uart0 (the board default), so the first
		 * USB interface keeps behaving like every other dongle application. The capture
		 * stream gets its own interface, because it carries binary PCAP-NG data that must
		 * not be interleaved with text.
		 */
		zephyr,sniffer-uart = &cdc_acm_uart1;
	};
};

&usbd {
	cdc_acm_uart1: cdc_acm_uart1 {
		compatible = "zephyr,cdc-acm-uart";
		/*
		 * A Wi-SUN PSDU may be up to 2047 octets. Four times the largest frame rather
		 * than twice it, because this buffer sits behind the application's own staging
		 * buffer and a frame that reaches it has already been counted as captured --
		 * losing it here would not show up in the drop counter.
		 */
		tx-fifo-size = <8192>;
	};
};
```

## src/led.c
```c
/*
 * SPDX-FileCopyrightText: Copyright (c) 2026 GARDENA GmbH
 * SPDX-License-Identifier: GPL-3.0-or-later
 */

#include "led.h"

#include <zephyr/devicetree.h>
#include <zephyr/drivers/gpio.h>
#include <zephyr/logging/log.h>

#include <errno.h>

LOG_MODULE_REGISTER(led, LOG_LEVEL_INF);

#if !DT_NODE_EXISTS(DT_ALIAS(led0))
#error "the Wi-SUN sniffer needs a board whose devicetree has an led0 alias"
#endif

/*
 * The only LED on the dongle the nRF52840 can drive. The power LED hangs off USB VBUS and the RX/TX
 * pair is wired to the Si4467, so neither is ours. On dongles before hardware revision 0.4.0 this
 * pin is not connected either, and there the calls below simply have nothing to show.
 */
static const struct gpio_dt_spec app_led = GPIO_DT_SPEC_GET(DT_ALIAS(led0), gpios);

/** Whether the pin was configured, so that a board without one is quiet rather than noisy. */
static bool led_ready;

int led_init(void)
{
	int ret;

	if (!gpio_is_ready_dt(&app_led)) {
		LOG_ERR("%s is not ready", app_led.port->name);
		return -ENODEV;
	}

	/* Dark until a capture tool attaches: unlit is the resting state, not an error state. */
	ret = gpio_pin_configure_dt(&app_led, GPIO_OUTPUT_INACTIVE);
	if (ret) {
		LOG_ERR("cannot drive %s pin %u: %d", app_led.port->name, app_led.pin, ret);
		return ret;
	}

	led_ready = true;

	return 0;
}

void led_set_capture_active(bool active)
{
	if (!led_ready) {
		return;
	}

	/*
	 * Nothing rests on this, and the caller is the DTR poll, which has better things to report
	 * than a GPIO write that failed once and would then fail again a quarter of a second later.
	 */
	(void)gpio_pin_set_dt(&app_led, active);
}
```

## src/led.h
```c
/*
 * SPDX-FileCopyrightText: Copyright (c) 2026 GARDENA GmbH
 * SPDX-License-Identifier: GPL-3.0-or-later
 */

/**
 * @file
 *
 * @brief The application LED, which shows whether a capture is running.
 *
 * With Wireshark on another screen, or a capture left running unattended, the dongle otherwise
 * gives no sign of what it is doing. Lit means a capture tool has the capture port open.
 */

#ifndef WISUN_SNIFFER_LED_H_
#define WISUN_SNIFFER_LED_H_

#include <stdbool.h>

/**
 * @brief Claim the LED and leave it dark.
 *
 * @return 0 on success, negative errno if the pin cannot be driven, in which case
 *         @ref led_set_capture_active does nothing rather than failing on every call.
 */
int led_init(void);

/**
 * @brief Light the LED while a capture tool is reading the capture stream.
 *
 * @param active true to light it, false to put it out.
 */
void led_set_capture_active(bool active);

#endif /* WISUN_SNIFFER_LED_H_ */
```

## src/pcapng.c
```c
/*
 * SPDX-FileCopyrightText: Copyright (c) 2026 GARDENA GmbH
 * SPDX-License-Identifier: GPL-3.0-or-later
 */

#include "pcapng.h"

#include "si4467_wisun.h"

#include <zephyr/device.h>
#include <zephyr/drivers/uart.h>
#include <zephyr/kernel.h>
#include <zephyr/logging/log.h>
#include <zephyr/sys/byteorder.h>
#include <zephyr/sys/ring_buffer.h>

#include <string.h>

LOG_MODULE_REGISTER(pcapng, LOG_LEVEL_INF);

/*
 * Binary capture data goes here, so it has to be a different UART than the console: the board puts
 * console, logging and shell on cdc_acm_uart0, boards/si4467_dongle_nrf52840.overlay adds
 * cdc_acm_uart1 for capture.
 */
static const struct device *const capture_uart = DEVICE_DT_GET(DT_CHOSEN(zephyr_sniffer_uart));

/* Block types (PCAP-NG specification section 4). */
#define BLOCK_TYPE_SHB 0x0A0D0D0AU
#define BLOCK_TYPE_IDB 0x00000001U
#define BLOCK_TYPE_EPB 0x00000006U

/** Lets a reader work out the byte order the writer used. */
#define BYTE_ORDER_MAGIC 0x1A2B3C4DU

/** DLT_IEEE802_15_4_TAP, the link type this application produces. */
#define LINKTYPE_IEEE802_15_4_TAP 283

/** Longest packet we can produce: the maximum PSDU plus a generous TAP header. */
#define SNAPLEN (WISUN_MAX_PSDU_LEN + 64)

/* Option codes shared by all blocks. */
#define OPT_ENDOFOPT       0
/* Section header block options. */
#define OPT_SHB_HARDWARE   2
#define OPT_SHB_OS         3
#define OPT_SHB_USERAPPL   4
/* Interface description block options. */
#define OPT_IF_NAME        2
#define OPT_IF_DESCRIPTION 3
#define OPT_IF_TSRESOL     9

/** Timestamps are microseconds, so if_tsresol is 10^-6. */
#define IF_TSRESOL_MICROSECONDS 6

/**
 * Enough for the section header and interface description blocks with all their options -- the
 * largest thing built here, since a packet block only buffers its own header -- with room to
 * spare for longer option strings. put_bytes() silently drops anything past this, which would
 * leave a short section header in the stream.
 */
#define BLOCK_BUF_SIZE 512

/**
 * Whether a capture tool has raised DTR on the capture port.
 *
 * This is how a reader announces itself, and the only such signal the port carries. The tools in
 * tools/ take the line low before they raise it, so that the edge below is seen even when the
 * previous capture left it high.
 */
static bool host_attached;

/** Told about both edges of the above; see @ref pcapng_set_attach_callback. */
static pcapng_attach_cb_t attach_cb;

/** Serialises whole blocks: the frame path and the monitor below both write to the stream. */
static K_MUTEX_DEFINE(stream_lock);

/* ------------------------------------------------------------------------------------------- */
/* Output staging                                                                               */
/* ------------------------------------------------------------------------------------------- */

/**
 * Staging buffer between the frame path and the USB stack.
 *
 * The capture UART cannot be written directly without risking a corrupt stream. It has no flow
 * control, so uart_poll_out() discards octets once the CDC ACM transmit buffers are full, and a
 * block that is cut short is far worse than a block that never arrives: PCAP-NG has no marker to
 * resynchronise on, so a reader that loses its place reads the following octets as a block header
 * and everything after that is garbage.
 *
 * Buffering here makes the whole block the unit that gets dropped. Space for a complete block is
 * claimed before any of it is written, so a block reaches the stream either intact or not at all.
 *
 * One producer, under stream_lock, and one consumer, uart_cb(), so the ring needs no lock of its
 * own.
 */
static uint8_t tx_buf[CONFIG_WISUN_SNIFFER_CAPTURE_BUF_SIZE];
static struct ring_buf tx_ring;

/** Frames dropped with a reader attached because the staging buffer was full; see "stats". */
static uint32_t dropped;

/**
 * @brief Claim space for a whole block, so it is never written in part.
 *
 * Call with stream_lock held, before the first emit() of a block -- once reserved, space cannot
 * disappear again (only uart_cb() consumes the buffer), so every emit() that follows is
 * guaranteed to fit.
 *
 * @return true if the block can be written, false if it has to be dropped.
 */
static bool reserve(size_t len)
{
	return ring_buf_space_get(&tx_ring) >= len;
}

static void emit(const uint8_t *data, size_t len)
{
	const uint32_t wrote = ring_buf_put(&tx_ring, data, len);

	__ASSERT(wrote == len, "PCAP-NG block truncated despite reserve()");
	ARG_UNUSED(wrote);

	uart_irq_tx_enable(capture_uart);
}

/**
 * @brief Move staged octets into the USB stack.
 *
 * The CDC ACM driver accepts uart_fifo_fill() and answers uart_irq_tx_ready() only from inside
 * this callback, which it runs on its work queue whenever transmit is enabled and it has room:
 * after uart_irq_tx_enable() and after each completed USB transfer. uart_fifo_fill() copies, and
 * reports how much it took, so the remainder simply stays staged for the next call.
 *
 * Transmit is disabled once the ring is empty, or the driver would call straight back for as long
 * as it has room.
 */
static void uart_cb(const struct device *dev, void *user_data)
{
	ARG_UNUSED(user_data);

	uart_irq_update(dev);

	while (!ring_buf_is_empty(&tx_ring)) {
		const int space = uart_irq_tx_ready(dev);
		uint8_t *data;
		uint32_t claimed;
		int wrote;

		if (space <= 0) {
			return;
		}

		claimed = MIN(ring_buf_get_ptr(&tx_ring, &data, 0), (uint32_t)space);
		wrote = uart_fifo_fill(dev, data, (int)claimed);
		if (wrote <= 0) {
			return;
		}

		ring_buf_consume(&tx_ring, (size_t)wrote);
	}

	uart_irq_tx_disable(dev);

	/* A block staged after the last check would otherwise wait for the next one. */
	if (!ring_buf_is_empty(&tx_ring)) {
		uart_irq_tx_enable(dev);
	}
}

/**
 * Serialises a block into a buffer so that its total length, which PCAP-NG stores both before and
 * after the block body, can be filled in once the body is complete.
 */
struct block {
	uint8_t data[BLOCK_BUF_SIZE];
	/** Octets used so far, which may span several blocks built back to back. */
	size_t len;
	/** Where the block currently being built starts. */
	size_t start;
};

static void put_bytes(struct block *b, const void *src, size_t len)
{
	if (len == 0) {
		return;
	}

	if (b->len + len > sizeof(b->data)) {
		/* Only reachable by editing the fixed blocks below, so a build time concern. */
		__ASSERT(false, "PCAP-NG block does not fit in %zu octets", sizeof(b->data));
		return;
	}

	memcpy(&b->data[b->len], src, len);
	b->len += len;
}

static void put_u16(struct block *b, uint16_t value)
{
	uint8_t raw[sizeof(value)];

	sys_put_le16(value, raw);
	put_bytes(b, raw, sizeof(raw));
}

static void put_u32(struct block *b, uint32_t value)
{
	uint8_t raw[sizeof(value)];

	sys_put_le32(value, raw);
	put_bytes(b, raw, sizeof(raw));
}

static void put_u64(struct block *b, uint64_t value)
{
	uint8_t raw[sizeof(value)];

	sys_put_le64(value, raw);
	put_bytes(b, raw, sizeof(raw));
}

/** @brief Pad the block out to the next 32 bit boundary, as every PCAP-NG field must be. */
static void put_padding(struct block *b)
{
	static const uint8_t zeroes[3] = {0};
	const size_t pad = (4 - (b->len % 4)) % 4;

	put_bytes(b, zeroes, pad);
}

static void put_option(struct block *b, uint16_t code, const void *value, uint16_t len)
{
	put_u16(b, code);
	put_u16(b, len);
	put_bytes(b, value, len);
	put_padding(b);
}

static void put_string_option(struct block *b, uint16_t code, const char *value)
{
	put_option(b, code, value, (uint16_t)strlen(value));
}

static void begin_block(struct block *b, uint32_t type)
{
	b->start = b->len;
	put_u32(b, type);
	put_u32(b, 0); /* Block total length, filled in by end_block(). */
}

/**
 * @brief Close a block by writing its total length, which appears both in the header and trailer.
 */
static void end_block(struct block *b)
{
	uint32_t block_len;

	put_option(b, OPT_ENDOFOPT, NULL, 0);
	put_u32(b, 0); /* Placeholder for the trailing copy of the total length. */

	block_len = (uint32_t)(b->len - b->start);
	sys_put_le32(block_len, &b->data[b->start + 4]);
	sys_put_le32(block_len, &b->data[b->len - 4]);
}

bool pcapng_write_section_header(void)
{
	static struct block b;
	bool written;

	k_mutex_lock(&stream_lock, K_FOREVER);

	/* Both blocks are built together so that they reach the stream as one piece or not at all.
	 */
	b.len = 0;

	begin_block(&b, BLOCK_TYPE_SHB);
	put_u32(&b, BYTE_ORDER_MAGIC);
	put_u16(&b, 1); /* Major version */
	put_u16(&b, 0); /* Minor version */
	/*
	 * Section length is unknown: this is a live stream, so how long it turns out to be depends
	 * on when the capture is stopped.
	 */
	put_u64(&b, UINT64_MAX);
	put_string_option(&b, OPT_SHB_HARDWARE, "GARDENA si4467_dongle/nrf52840 with Si4467");
	put_string_option(&b, OPT_SHB_OS, "Zephyr");
	put_string_option(&b, OPT_SHB_USERAPPL, "wisun_sniffer");
	end_block(&b);

	begin_block(&b, BLOCK_TYPE_IDB);
	put_u16(&b, LINKTYPE_IEEE802_15_4_TAP);
	put_u16(&b, 0); /* Reserved */
	put_u32(&b, SNAPLEN);
	put_string_option(&b, OPT_IF_NAME, "wisun0");
	/*
	 * No PHY here: it can change in the middle of a section, so each frame's TAP header is
	 * where its channel and bit rate are.
	 */
	put_string_option(&b, OPT_IF_DESCRIPTION, "Wi-SUN FAN");
	put_option(&b, OPT_IF_TSRESOL, &(uint8_t){IF_TSRESOL_MICROSECONDS}, 1);
	end_block(&b);

	/*
	 * Both blocks are reserved as one piece as well: an interface description that arrives
	 * without its section header, or the other way round, leaves a reader unable to decode
	 * anything.
	 */
	written = reserve(b.len);
	if (written) {
		emit(b.data, b.len);
	}

	k_mutex_unlock(&stream_lock);

	return written;
}

void pcapng_write_packet(uint64_t timestamp_us, const uint8_t *header, size_t header_len,
			 const uint8_t *payload, size_t payload_len)
{
	static const uint8_t zeroes[3] = {0};
	const size_t packet_len = header_len + payload_len;
	const size_t padding = (4 - (packet_len % 4)) % 4;
	/* Block header and trailer: type, length, interface, timestamp, two lengths, length again.
	 */
	const uint32_t block_len = 32 + (uint32_t)(packet_len + padding);
	struct block b;

	k_mutex_lock(&stream_lock, K_FOREVER);

	/*
	 * Drop the whole frame if it does not fit. A capture that is missing a frame still decodes;
	 * one containing half a block does not, and cannot be recovered from either.
	 */
	if (!reserve(block_len)) {
		/*
		 * Only counted while a reader is attached: with none, the buffer fills and stays
		 * full, and what is dropped then was never going to reach anyone.
		 */
		if (host_attached) {
			dropped++;
		}
		k_mutex_unlock(&stream_lock);
		return;
	}

	b.len = 0;
	begin_block(&b, BLOCK_TYPE_EPB);
	put_u32(&b, 0);                              /* Interface ID, the only interface */
	put_u32(&b, (uint32_t)(timestamp_us >> 32)); /* Timestamp, high half */
	put_u32(&b, (uint32_t)timestamp_us);         /* Timestamp, low half */
	put_u32(&b, (uint32_t)packet_len);           /* Captured length, we never truncate */
	put_u32(&b, (uint32_t)packet_len);           /* Original length */
	sys_put_le32(block_len, &b.data[4]);

	emit(b.data, b.len);
	emit(header, header_len);
	emit(payload, payload_len);
	emit(zeroes, padding);

	/* The trailing copy of the block total length. */
	b.len = 0;
	put_u32(&b, block_len);
	emit(b.data, b.len);

	k_mutex_unlock(&stream_lock);
}

/* ------------------------------------------------------------------------------------------- */
/* Host attach detection                                                                        */
/* ------------------------------------------------------------------------------------------- */

/**
 * How often the capture port is checked -- imperceptible against a person pressing a button, and
 * also how long a reader must hold DTR low for the following edge to register, which is why
 * tools/wisun_sniffer_capture.py holds it low for twice as long.
 */
#define MONITOR_INTERVAL K_MSEC(250)

static void monitor(struct k_work *work);
static K_WORK_DELAYABLE_DEFINE(monitor_work, monitor);

/**
 * @brief Start a section whenever a capture tool attaches.
 *
 * A reader has to see a section header and an interface description before it will accept any
 * packet, and it looks for them once, when it opens the stream. Writing them on the rising edge of
 * DTR is what puts them there in time; the tools in tools/ raise it as their last step before they
 * start reading, and discard whatever precedes the header.
 */
static void monitor(struct k_work *work)
{
	uint32_t dtr = 0;
	bool attached = false;

	ARG_UNUSED(work);

	if (uart_line_ctrl_get(capture_uart, UART_LINE_CTRL_DTR, &dtr) == 0) {
		attached = dtr != 0;
	}

	if (attached != host_attached) {
		if (attached) {
			LOG_INF("capture tool attached, starting a new PCAP-NG section");

			if (!pcapng_write_section_header()) {
				LOG_WRN("no room for the section header; the reader will see "
					"nothing it can decode");
			}
		}

		/* Before the callback, so that it and pcapng_host_attached() cannot disagree. */
		host_attached = attached;

		if (attach_cb != NULL) {
			attach_cb(attached);
		}
	}

	k_work_reschedule(&monitor_work, MONITOR_INTERVAL);
}

void pcapng_set_attach_callback(pcapng_attach_cb_t cb)
{
	attach_cb = cb;
}

bool pcapng_host_attached(void)
{
	/*
	 * Read without the lock. It is a single word written by the monitor work item and read by
	 * the receive thread, and the answer is one poll interval stale in any case, so a lock
	 * would buy nothing but the illusion of precision.
	 */
	return host_attached;
}

uint32_t pcapng_get_dropped(void)
{
	return dropped;
}

void pcapng_reset_dropped(void)
{
	/*
	 * Under the lock the counter is incremented with, so a frame being dropped right now counts
	 * against the old total or against the new one, and cannot fall between them.
	 */
	k_mutex_lock(&stream_lock, K_FOREVER);
	dropped = 0;
	k_mutex_unlock(&stream_lock);
}

int pcapng_init(void)
{
	int ret;

	if (!device_is_ready(capture_uart)) {
		LOG_ERR("capture UART %s is not ready", capture_uart->name);
		return -ENODEV;
	}

	ring_buf_init(&tx_ring, sizeof(tx_buf), tx_buf);

	ret = uart_irq_callback_user_data_set(capture_uart, uart_cb, NULL);
	if (ret != 0) {
		LOG_ERR("capture UART %s has no interrupt API (%d)", capture_uart->name, ret);
		return ret;
	}

	k_work_reschedule(&monitor_work, MONITOR_INTERVAL);

	return 0;
}
```

## src/pcapng.h
```c
/*
 * SPDX-FileCopyrightText: Copyright (c) 2026 GARDENA GmbH
 * SPDX-License-Identifier: GPL-3.0-or-later
 */

/**
 * @file
 *
 * @brief PCAP-NG capture stream, written to the capture UART.
 *
 * Produces a live PCAP-NG stream that Wireshark can read straight from a pipe, using link type
 * 283 (DLT_IEEE802_15_4_TAP). The stream is a section header block and an interface description
 * block followed by one enhanced packet block per frame. Every block is little-endian and padded
 * to a 32 bit boundary.
 */

#ifndef WISUN_SNIFFER_PCAPNG_H_
#define WISUN_SNIFFER_PCAPNG_H_

#include <stdbool.h>
#include <stddef.h>
#include <stdint.h>

/**
 * @brief Claim the capture UART and start watching for a capture tool attaching to it.
 *
 * @return 0 on success, negative errno otherwise.
 */
int pcapng_init(void);

/**
 * @brief Emit the section header and interface description blocks.
 *
 * Called automatically whenever a capture tool opens the capture port, so that a host attaching
 * long after boot sees a well-formed section rather than a packet block out of nowhere. A reader
 * that cannot raise DTR can ask for one from the shell instead.
 *
 * @return true if both blocks reached the stream, false if the staging buffer had no room for
 *         them, which means nothing is draining the capture port.
 */
bool pcapng_write_section_header(void);

/**
 * @brief Emit one enhanced packet block.
 *
 * The packet data is written from two pieces so that the frame does not have to be copied into a
 * contiguous buffer first.
 *
 * @param timestamp_us Capture time, in microseconds since boot.
 * @param header IEEE 802.15.4 TAP header and its TLVs.
 * @param header_len Length of @p header, in bytes.
 * @param payload PHY payload, following the TAP header.
 * @param payload_len Length of @p payload, in bytes.
 */
void pcapng_write_packet(uint64_t timestamp_us, const uint8_t *header, size_t header_len,
			 const uint8_t *payload, size_t payload_len);

/**
 * @brief Whether a capture tool is reading the capture port.
 *
 * True from the moment DTR is seen up until it goes down again. Polled, so it can be up to one
 * poll interval out of date, which is why nothing that must be exact should rest on it.
 */
bool pcapng_host_attached(void);

/**
 * @brief Called when a capture tool attaches to the capture port, or lets go of it.
 *
 * Runs on the system work queue, from the same poll that decides to start a new section, and only
 * when the answer changes. @ref pcapng_host_attached already reports @p attached by the time this
 * is called.
 *
 * @param attached true when a reader has just raised DTR, false when it has dropped it.
 */
typedef void (*pcapng_attach_cb_t)(bool attached);

/**
 * @brief Register a function to be told when a capture tool comes and goes.
 *
 * Keeps whatever the dongle does about it -- lighting an LED, quietening the console -- out of the
 * stream writer, which has no business knowing about either.
 *
 * @param cb Called on each change, or NULL to stop being called.
 */
void pcapng_set_attach_callback(pcapng_attach_cb_t cb);

/**
 * @brief Number of frames left out of the stream because the capture host was not keeping up.
 *
 * A frame is dropped whole rather than written in part, so the stream stays decodable; this counter
 * is the only way to tell that anything is missing from it.
 */
uint32_t pcapng_get_dropped(void);

/**
 * @brief Zero the dropped frame counter.
 *
 * Belongs with the receive counters in si4467_wisun.h: the two are read together and only mean
 * anything from the same starting point.
 */
void pcapng_reset_dropped(void);

#endif /* WISUN_SNIFFER_PCAPNG_H_ */
```

## src/si4467_fec.c
```c
/*
 * SPDX-FileCopyrightText: Copyright (c) 2026 GARDENA GmbH
 * SPDX-License-Identifier: GPL-3.0-or-later
 */

#include "si4467_fec.h"

#include <errno.h>
#include <string.h>

/**
 * The code has three memory elements, so the trellis has eight states; IEEE 802.15.4-2020 19.3.5.
 * A state holds the three bits that went in before the current one, most recent first:
 * bit 2 is b(i-1), bit 1 is b(i-2), bit 0 is b(i-3).
 */
#define NUM_STATES 8

/**
 * How far back a survivor is followed before its oldest bit is believed.
 *
 * The usual rule of thumb is five constraint lengths, which is 20 bits here. Thirty-two is the
 * next whole interleaver block above that, which costs nothing and keeps the window aligned with
 * the blocks being fed in.
 */
#define TRACEBACK_DEPTH 32

/** Worse than any reachable path metric, so an unreachable state never wins a comparison. */
#define METRIC_MAX UINT16_MAX

/**
 * @brief One step of the PN9 generator; IEEE 802.15.4-2020 16.2.3.
 *
 * The bit that comes out is the feedback term, not a bit of the register. Getting that wrong
 * still produces a plausible looking pseudo-random sequence, just not this one.
 */
static uint8_t pn9_next(uint16_t *state)
{
	uint8_t out = (uint8_t)((*state ^ (*state >> 5)) & 1);

	*state = (uint16_t)((*state >> 1) | ((uint16_t)out << 8));

	return out;
}

void wisun_fec_descramble(uint8_t *data, size_t len, size_t skip)
{
	uint16_t state = 0x1FF;

	for (size_t i = skip; i < len; i++) {
		uint8_t mask = 0;

		for (uint8_t bit = 0; bit < 8; bit++) {
			mask |= (uint8_t)(pn9_next(&state) << bit);
		}

		data[i] ^= mask;
	}
}

size_t wisun_fec_coded_len(uint16_t psdu_len)
{
	/*
	 * The encoder runs over the PHR and the PSDU together, then three tail bits return it to
	 * the zero state, then padding rounds the result up to whole interleaver blocks. The
	 * standard states the padding as 5 or 13 bits depending on whether the octet count so far
	 * is odd, which is the same as saying tail and padding together occupy one whole octet or
	 * two.
	 */
	size_t octets = (size_t)psdu_len + sizeof(uint16_t);
	size_t info_bits = (octets + ((octets % 2 == 1) ? 1 : 2)) * 8;

	/* Rate 1/2, so twice the bits, and they are counted here in octets. */
	return info_bits / 4;
}

/** @brief Bit @p index of a received stream, which arrives least significant bit of an octet first.
 */
static uint8_t coded_bit(const uint8_t *coded, size_t index)
{
	return (uint8_t)((coded[index / 8] >> (index % 8)) & 1);
}

/**
 * @brief Undo the interleaving of one block, recovering its sixteen code symbols in order.
 *
 * IEEE 802.15.4-2020 19.3.6 permutes whole code symbols rather than single bits, writing
 * q(p)(k) = a(p)(t) with t = 15 - 4*(k mod 4) - floor(k/4). Reading that backwards is all this is:
 * the symbol received k-th belongs at position t.
 *
 * @param coded    Coded frame as received.
 * @param block    Which interleaver block to undo, counting from zero.
 * @param symbols  Filled with the block's symbols in transmission order, two bits each: bit 1 is
 *                 the first of the pair on air, bit 0 the second.
 */
static void deinterleave(const uint8_t *coded, size_t block, uint8_t *symbols)
{
	size_t base = block * WISUN_FEC_BLOCK_CODED_BITS;

	for (size_t k = 0; k < WISUN_FEC_BLOCK_BITS; k++) {
		size_t t = 15 - 4 * (k % 4) - (k / 4);
		uint8_t first = coded_bit(coded, base + 2 * k);
		uint8_t second = coded_bit(coded, base + 2 * k + 1);

		symbols[t] = (uint8_t)((first << 1) | second);
	}
}

/**
 * @brief The pair of bits the encoder emits leaving @p state on input @p input.
 *
 * IEEE 802.15.4-2020 19.3.5, the non-recursive non-systematic code. Both outputs are the
 * complement of a sum, which is easy to drop when reading the figure and produces a decoder that
 * inverts every bit it recovers.
 */
static uint8_t encode_symbol(uint8_t state, uint8_t input)
{
	uint8_t m1 = (uint8_t)((state >> 2) & 1);
	uint8_t m2 = (uint8_t)((state >> 1) & 1);
	uint8_t m3 = (uint8_t)(state & 1);
	uint8_t u1 = (uint8_t)(!(input ^ m2 ^ m3));
	uint8_t u0 = (uint8_t)(!(input ^ m1 ^ m2 ^ m3));

	return (uint8_t)((u1 << 1) | u0);
}

/**
 * Which of a state's two predecessors its survivor came from, one octet per stage: bit @c s is the
 * decision for state @c s.
 *
 * A whole frame's worth, because the traceback then runs once from the end rather than once per
 * bit. Following a survivor 32 stages back for every one of a frame's several thousand bits is
 * what made decoding take tens of milliseconds, which is longer than the gap before the
 * acknowledgment that answers the frame.
 */
static uint8_t decisions[WISUN_FEC_MAX_CODED_OCTETS * 4];

/**
 * @brief Run the trellis over @p blocks of code symbols, filling @ref decisions.
 *
 * @param coded   Coded frame, descrambled.
 * @param blocks  Interleaver blocks to process.
 * @param metric  Set to the cost of the surviving path.
 *
 * @return The state that path ends in.
 */
static uint8_t forward(const uint8_t *coded, size_t blocks, uint16_t *metric)
{
	/*
	 * The two output bits of every branch, worked out once and indexed by state and input.
	 * There are only sixteen, and deriving them per symbol was a measurable part of the cost.
	 */
	uint8_t expected[NUM_STATES * 2];
	uint16_t buffer[2][NUM_STATES];
	uint16_t *cost = buffer[0];
	uint16_t *next = buffer[1];
	uint8_t best = 0;
	size_t stage = 0;

	for (uint8_t s = 0; s < NUM_STATES; s++) {
		expected[s * 2] = encode_symbol(s, 0);
		expected[s * 2 + 1] = encode_symbol(s, 1);

		/*
		 * The encoder starts in the zero state. A penalty rather than an impossible value,
		 * so that the loop below needs no test for one: it is far more than a frame of this
		 * length can accumulate honestly, and small enough that adding to it cannot
		 * overflow.
		 */
		cost[s] = (s == 0) ? 0 : 1000;
	}

	for (size_t block = 0; block < blocks; block++) {
		uint8_t symbols[WISUN_FEC_BLOCK_BITS];

		deinterleave(coded, block, symbols);

		for (size_t i = 0; i < WISUN_FEC_BLOCK_BITS; i++) {
			const uint8_t symbol = symbols[i];
			uint16_t *swap;
			uint8_t decision = 0;

			/*
			 * Add, compare, select, once per state rather than once per branch. Every
			 * state has exactly two predecessors -- they differ only in the bit that is
			 * about to fall out of the register -- so both can be reached without
			 * searching for them, and the decision is which of the two won.
			 */
			for (uint8_t n = 0; n < NUM_STATES; n++) {
				const uint8_t input = (uint8_t)((n >> 2) & 1);
				const uint8_t low = (uint8_t)((n & 0x03) << 1);
				const uint8_t wrong0 =
					(uint8_t)(expected[low * 2 + input] ^ symbol);
				const uint8_t wrong1 =
					(uint8_t)(expected[(low + 1) * 2 + input] ^ symbol);
				const uint16_t from0 =
					(uint16_t)(cost[low] + ((wrong0 >> 1) & 1) + (wrong0 & 1));
				const uint16_t from1 =
					(uint16_t)(cost[low + 1] + ((wrong1 >> 1) & 1) +
						   (wrong1 & 1));

				if (from1 < from0) {
					next[n] = from1;
					decision |= (uint8_t)(1U << n);
				} else {
					next[n] = from0;
				}
			}

			/* Swapped rather than copied: the same sixteen octets, moved by two
			 * pointers.
			 */
			swap = cost;
			cost = next;
			next = swap;

			decisions[stage++] = decision;
		}
	}

	for (uint8_t s = 1; s < NUM_STATES; s++) {
		if (cost[s] < cost[best]) {
			best = s;
		}
	}

	*metric = cost[best];

	return best;
}

/**
 * @brief Walk the survivors back from @p state, writing the bits they were made of.
 *
 * Once, from the end of the frame to the start, which is what the whole of @ref decisions is kept
 * for. @p out is written least significant bit of each octet first and must arrive zeroed.
 *
 * The last few bits are the encoder's tail and padding rather than the frame, and the state the
 * padding left it in is not known, so those are wrong and are meant to be: nothing reads past the
 * PHY header and PSDU.
 */
static void traceback(size_t stages, uint8_t state, uint8_t *out)
{
	for (size_t i = stages; i-- > 0;) {
		/* Bit 2 of a state is the input that moved the encoder into it. */
		out[i / 8] |= (uint8_t)(((state >> 2) & 1) << (i % 8));
		state = (uint8_t)(((state & 0x03) << 1) | ((decisions[i] >> state) & 1));
	}
}

int wisun_fec_decode_phr(const uint8_t *coded, uint16_t *phr)
{
	uint8_t bits[WISUN_FEC_BLOCK_BITS / 8] = {0};
	uint16_t metric;
	uint8_t state;

	/*
	 * The frame runs on past this block, so there is no terminated state to start from and the
	 * best path stands in for one. With three memory elements the survivors have long since
	 * merged, so these are the same sixteen bits the full decode reaches; the header is only
	 * being read early to learn how much more of the frame to collect.
	 */
	state = forward(coded, 1, &metric);
	traceback(WISUN_FEC_BLOCK_BITS, state, bits);

	/* Most significant bit first, which is how the header alone is sent. */
	*phr = 0;

	for (size_t i = 0; i < WISUN_FEC_BLOCK_BITS; i++) {
		*phr = (uint16_t)((*phr << 1) | ((bits[i / 8] >> (i % 8)) & 1));
	}

	return 0;
}

int wisun_fec_decode(const uint8_t *coded, size_t coded_len, uint8_t *out, size_t out_len,
		     size_t *decoded_len, size_t *corrections)
{
	const size_t blocks = coded_len / WISUN_FEC_BLOCK_CODED_OCTETS;
	const size_t stages = blocks * WISUN_FEC_BLOCK_BITS;
	uint16_t metric;
	uint8_t state;

	if (coded_len == 0 || coded_len % WISUN_FEC_BLOCK_CODED_OCTETS != 0) {
		return -EINVAL;
	}

	if (coded_len > WISUN_FEC_MAX_CODED_OCTETS) {
		return -EMSGSIZE;
	}

	if (out_len < stages / 8) {
		return -ENOSPC;
	}

	memset(out, 0, stages / 8);

	state = forward(coded, blocks, &metric);
	traceback(stages, state, out);

	*decoded_len = stages / 8;

	if (corrections != NULL) {
		/* The survivor's metric is the number of received bits the decoder overruled. */
		*corrections = metric;
	}

	return 0;
}
```

## src/si4467_fec.h
```c
/*
 * SPDX-FileCopyrightText: Copyright (c) 2026 GARDENA GmbH
 * SPDX-License-Identifier: GPL-3.0-or-later
 */

/**
 * @file
 *
 * @brief Undoing the forward error correction of a SUN FSK frame, in software.
 *
 * The transceiver has no convolutional decoder -- its datasheet says so outright (section 9.3.6:
 * it can tell the host whether FEC was used, and nothing more) -- so everything a coded frame
 * needs after the demodulator is done here.
 *
 * A transmitter builds a coded frame in this order, established by decoding real traffic rather
 * than from the standard: the PHR and PSDU are convolutionally encoded and interleaved, and the
 * whitening is then applied to the code symbols -- but only to those of the PSDU. The encoded PHY
 * header, which is exactly the first interleaver block, is left alone.
 *
 * Receiving runs that backwards: descramble everything past that first block, deinterleave, Viterbi
 * decode, and what falls out is the PHY header followed by the PSDU with nothing left to undo.
 *
 * This is what IEEE 802.15.4-2020 describes, once its clauses are read in the order they are
 * numbered. 19.3.2 is the *reference modulator*, a transmit-side data flow, and the steps follow
 * it: 19.3.5 the coding, 19.3.6 the interleaving, and only then 19.4 the whitening. 16.2.3, which
 * 19.4 defers to, starts the generator at "the first bit of the PSDU" -- in a coded frame, the
 * PSDU's first code symbol, which is where it is started here.
 *
 * It is worth stating because the opposite order is an easy thing to come away with, and a decoder
 * built that way recovers nothing at all: it hands whitened symbols to the Viterbi decoder, which
 * cannot tell them from noise. The transceiver's own de-whitener has to stay off regardless, since
 * it would run over a different span than the transmitter's did.
 *
 * Nothing here talks to the transceiver, which is what lets it be tested on native_sim.
 */

#ifndef WISUN_SNIFFER_SI4467_FEC_H_
#define WISUN_SNIFFER_SI4467_FEC_H_

#include <stddef.h>
#include <stdint.h>

/**
 * Information bits one interleaver block carries; IEEE 802.15.4-2020 19.3.6.
 *
 * It is 16, which is exactly the width of the PHY header. That is what makes a coded frame
 * receivable at all without buffering the largest one the PHY allows: the first block decodes to
 * the PHR, the PHR gives the PSDU length, and the length says how much more to collect.
 */
#define WISUN_FEC_BLOCK_BITS 16

/** Coded bits one interleaver block occupies on air. The code has rate 1/2, so twice the above. */
#define WISUN_FEC_BLOCK_CODED_BITS (WISUN_FEC_BLOCK_BITS * 2)

/** Coded octets one interleaver block occupies on air. */
#define WISUN_FEC_BLOCK_CODED_OCTETS (WISUN_FEC_BLOCK_CODED_BITS / 8)

/**
 * Coded octets at the head of a frame that carry no whitening: the encoded PHY header.
 *
 * The header occupies the first interleaver block exactly, so the whitening begins on the block
 * boundary after it and the generator starts from its seed there.
 */
#define WISUN_FEC_UNSCRAMBLED_OCTETS WISUN_FEC_BLOCK_CODED_OCTETS

/**
 * Capacity for the longest coded frame, with headroom above it.
 *
 * @ref wisun_fec_coded_len of the largest PSDU -- 2047 octets -- is 4100, so a legal frame never
 * needs more than that and anything longer is not one. The extra is deliberate all the same: this
 * is the bound on a buffer the receive path fills straight from the air, and the cost of carrying
 * a quarter of a kilobyte nobody uses is nothing next to having to be sure the arithmetic above is
 * exact. Over-running it is handled rather than fatal either way -- collection stops at the bound
 * and the reception is counted as over-long.
 *
 * The decoder also keeps one octet of survivor decisions per information bit, so this sizes that
 * array too, and the receive path sizes the buffers it collects into to match.
 */
#define WISUN_FEC_MAX_CODED_OCTETS 4352

/**
 * @brief Undo the PN9 whitening of a coded frame, in place.
 *
 * IEEE 802.15.4-2020 16.2.3. The generator is x^9 + x^5 + 1 seeded with all ones, and the bit it
 * contributes is the feedback term itself rather than a register bit -- which is what makes the
 * sequence open 0000 1111 0111 rather than with the seed. Check any reimplementation against
 * those bits before trusting it.
 *
 * Applied to the code symbols, before anything else: on this PHY the whitening is the last thing
 * the transmitter does, so it is the first thing a receiver undoes.
 *
 * @param data  Octets to descramble, least significant bit of each first.
 * @param len   Length of @p data in octets.
 * @param skip  Octets at the front to leave alone before the generator starts;
 *              @ref WISUN_FEC_UNSCRAMBLED_OCTETS for a frame, zero for the bare sequence.
 */
void wisun_fec_descramble(uint8_t *data, size_t len, size_t skip);

/**
 * @brief How many coded octets a frame occupies on air.
 *
 * Counts the PHR, the PSDU, the three tail bits that return the encoder to the zero state and the
 * padding that rounds the block up to whole interleaver blocks, then doubles it for the code rate.
 * This is what tells the receive path when a coded frame has been collected in full; the length in
 * the PHR describes the frame before it was encoded and is about half of it.
 *
 * @param psdu_len  PSDU length in octets, including the FCS, as the PHR states it.
 *
 * @return Coded length in octets.
 */
size_t wisun_fec_coded_len(uint16_t psdu_len);

/**
 * @brief Decode the PHY header out of the first interleaver block.
 *
 * Enough of a coded frame to learn how long the rest of it is. The convolutional code runs on
 * past the end of the block, so this cannot be a terminated decode; it traces back from the best
 * path instead, which for a code with three memory elements has settled long before the 16 bits
 * are out.
 *
 * The header is the one field a SUN FSK transmitter sends most significant bit first, the rest of
 * the frame going out least significant bit first, so it is returned as a value rather than as
 * octets -- there is no octet order to hand back that would not be a trap.
 *
 * @param coded  First @ref WISUN_FEC_BLOCK_CODED_OCTETS octets of the frame, already descrambled.
 * @param phr    Filled with the decoded PHY header; IEEE 802.15.4-2020 figure 19-4.
 *
 * @return 0 on success, negative errno otherwise.
 */
int wisun_fec_decode_phr(const uint8_t *coded, uint16_t *phr);

/**
 * @brief Decode a complete coded frame.
 *
 * Deinterleaves and Viterbi decodes, leaving the encoded PHY header's two octets followed by the
 * PSDU, which is already plaintext -- the whitening came off the code symbols before this ran.
 * Read the header with @ref wisun_fec_decode_phr rather than from @p out, whose first two octets
 * hold its bits in the opposite order.
 *
 * @param coded        Coded frame as received, @ref wisun_fec_coded_len octets of it.
 * @param coded_len    Length of @p coded in octets.
 * @param out          Filled with the PHR and then the PSDU.
 * @param out_len      Room in @p out, in octets.
 * @param decoded_len  Set to the number of octets written to @p out.
 * @param corrections  Set to the code symbols the decoder had to disagree with, or NULL. On a
 *                     link that is merely short of signal this is small; on one that is not
 *                     carrying a coded frame at all it is about a quarter of the symbols, which
 *                     is the cheapest way to tell a damaged frame from something that was never
 *                     a frame. Both bench links measured here decode at zero.
 *
 * @return 0 on success, -EINVAL if @p coded_len is not a whole number of interleaver blocks,
 *         -ENOSPC if @p out is too small.
 */
int wisun_fec_decode(const uint8_t *coded, size_t coded_len, uint8_t *out, size_t out_len,
		     size_t *decoded_len, size_t *corrections);

#endif /* WISUN_SNIFFER_SI4467_FEC_H_ */
```

## src/tap.h
```c
/*
 * SPDX-FileCopyrightText: Copyright (c) 2026 GARDENA GmbH
 * SPDX-License-Identifier: GPL-3.0-or-later
 */

/**
 * @file
 *
 * @brief IEEE 802.15.4 TAP header, the metadata Wireshark reads alongside each frame.
 *
 * Every captured frame is presented as a TAP packet: a short header, a series of type-length-value
 * fields describing how the frame was received, and then the PHY payload itself. See "IEEE 802.15.4
 * TAP Link Type Specification" version 1.0 in doc/.
 */

#ifndef WISUN_SNIFFER_TAP_H_
#define WISUN_SNIFFER_TAP_H_

#include "si4467_wisun.h"

#include <stddef.h>
#include <stdint.h>

/** Enough for the TAP header and every TLV this application emits. */
#define TAP_HEADER_MAX_LEN 64

/**
 * @brief Build the TAP header and TLVs describing @p frame.
 *
 * The PHY payload is not copied; it follows the header in the capture stream.
 *
 * @param buf  Destination, at least @ref TAP_HEADER_MAX_LEN octets.
 * @param frame Frame to describe.
 *
 * @return Number of octets written to @p buf.
 */
size_t tap_build_header(uint8_t *buf, const struct wisun_frame *frame);

#endif /* WISUN_SNIFFER_TAP_H_ */
```
