## boards/gardena/dongle/Kconfig.dongle
```kconfig
# SPDX-FileCopyrightText: Copyright (c) 2023 GARDENA GmbH
# SPDX-License-Identifier: Apache-2.0

config BOARD_DONGLE
	select SOC_NRF52840_QIAA
```

## boards/gardena/si4467_dongle/Kconfig.si4467_dongle
```kconfig
# SPDX-FileCopyrightText: Copyright (c) 2023 GARDENA GmbH
# SPDX-License-Identifier: Apache-2.0

config BOARD_SI4467_DONGLE
	select SOC_NRF52840_QIAA
```

## boards/gardena/si4467_dongle/board.yml
```yaml
# SPDX-FileCopyrightText: Copyright (c) 2024 GARDENA GmbH
# SPDX-License-Identifier: Apache-2.0

board:
  name: si4467_dongle
  full_name: Si4467 Dongle
  vendor: gardena
  socs:
    - name: nrf52840
```

## boards/gardena/si4467_dongle/si4467_dongle_nrf52840_defconfig
```kconfig
# SPDX-FileCopyrightText: Copyright (c) 2023 GARDENA GmbH
# SPDX-License-Identifier: GPL-3.0-or-later

# Enable MPU
CONFIG_ARM_MPU=y

# Enable hardware stack protection
CONFIG_HW_STACK_PROTECTION=y

# Enable GPIO
CONFIG_GPIO=y

# Enable pin control (see https://docs.zephyrproject.org/latest/hardware/pinctrl/index.html)
CONFIG_PINCTRL=y
```

## dts/bindings/transceiver/silabs,si4467.yaml
```yaml
# Copyright (c) 2021 GARDENA GmbH
# SPDX-License-Identifier: Apache-2.0

description: Silicon Labs Si4467 Sub-GHz transceiver

compatible: "silabs,si4467"

include: spi-device.yaml

properties:
  nirq-gpios:
    type: phandle-array
    required: true
    description: Interrupt pin.

      The interrupt pin nIRQ of Si4467 is active low input on the MCU.

  nirq-handling-gpios:
    type: phandle-array
    required: false
    description: Optional pin to analyze time spent handling the nIRQ.

  cca-in-progress-gpios:
    type: phandle-array
    required: false
    description: Optional pin to analyze time spent doing clear channel assessments.

  sdn-gpios:
    type: phandle-array
    required: true
    description: Shutdown pin.

      The shutdown (SDN) pin of Si4467 is active high.

  gpio-0-gpios:
    type: phandle-array
    required: false
    description: Si4467 GPIO 0, used for CCA

  gpio-1-gpios:
    type: phandle-array
    required: false
    description: Si4467 GPIO 1, reserved for later use.

  gpio-2-gpios:
    type: phandle-array
    required: false
    description: Si4467 GPIO 2

  gpio-3-gpios:
    type: phandle-array
    required: false
    description: Si4467 GPIO 3

  xtal-frequency:
    type: int
    required: true
    description: Clock frequency of XTAL in Hz

  xtal-capacitor-tune-value:
    type: int
    required: false
    description: >-
      Clock crystal capacitor tune value.

      This controls the capacitance of the internal capacitors for the crystal oscillator. The
      range is from 0 to 0x7f inclusive and each LSB step corresponds to ~70 fF change in
      capacitance. The ideal value must be determined experimentally and it can be left blank if
      individual calibration per device is used.

  rx-enable-gpios:
    type: phandle-array
    required: false
    description: RX enable pin. Controls the TX/RX switch.

  tx-enable-gpios:
    type: phandle-array
    required: false
    description: TX enable pin. Controls the TX/RX switch.

  rx-rssi-offset:
    type: int
    required: false
    description: >-
      RSSI offset in RX path due to analog front-end. Subtracted from RSSI
      value as reported by the Si4467 transceiver to get corrected value.
```

## tests/application/wisun_sniffer/fec/testcase.yaml
```yaml
# SPDX-FileCopyrightText: Copyright (c) 2026 GARDENA GmbH
# SPDX-License-Identifier: GPL-3.0-or-later

tests:
  wisun_sniffer.fec:
    tags: wisun_sniffer, fec
    platform_allow:
      - native_sim
      - native_sim/native/64
```
